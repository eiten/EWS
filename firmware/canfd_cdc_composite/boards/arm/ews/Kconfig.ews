## firmware/canfd_cdc_composite/boards/arm/ews/Kconfig.ews
```kconfig
# Copyright (c) 2025 EWS
# SPDX-License-Identifier: Apache-2.0

config BOARD_EWS
	select SOC_STM32G0B1XX
```

## firmware/canfd_cdc_composite/boards/arm/ews/board.yml
```yaml
board:
  name: ews
  full_name: EWS Board
  vendor: others
  socs:
    - name: stm32g0b1xx
```

## firmware/canfd_cdc_composite/boards/arm/ews_board/ews_board_defconfig
```kconfig
# EWS Board Configuration

CONFIG_SOC_SERIES_STM32G0X=y
CONFIG_SOC_STM32G0B1XX=y

# Clock configuration - USB clock sync, no external crystal
CONFIG_CLOCK_CONTROL=y
CONFIG_CLOCK_STM32_HSI=y
CONFIG_CLOCK_STM32_PLL_SRC_HSI=y
CONFIG_CLOCK_STM32_PLL_M_DIVISOR=1
CONFIG_CLOCK_STM32_PLL_N_MULTIPLIER=8
CONFIG_CLOCK_STM32_PLL_Q_DIVISOR=2
CONFIG_CLOCK_STM32_PLL_R_DIVISOR=2

# USB 48MHz from PLL
CONFIG_CLOCK_STM32_PLL_Q_DIVISOR=2

# Enable GPIO
CONFIG_GPIO=y

# Enable CAN
CONFIG_CAN=y
```

## firmware/canfd_cdc_composite/build/Kconfig/Kconfig.shield.defconfig
```kconfig
osource "C:/Users/iteedi/zephyrproject/projects/EWS/firmware/canfd_cdc_composite/boards/shields/*/Kconfig.defconfig"
```

## firmware/canfd_cdc_composite/build/Kconfig/boards/Kconfig.defconfig
```kconfig
# Load Zephyr board defconfig descriptions.
osource "C:/Users/iteedi/zephyrproject/projects/EWS/firmware/canfd_cdc_composite/boards/arm/ews/Kconfig.defconfig"
```

## firmware/canfd_cdc_composite/build/Kconfig/boards/Kconfig.sysbuild
```kconfig
# Load Sysbuild board Kconfig descriptions.
osource "C:/Users/iteedi/zephyrproject/projects/EWS/firmware/canfd_cdc_composite/boards/arm/ews/Kconfig.sysbuild"
```
